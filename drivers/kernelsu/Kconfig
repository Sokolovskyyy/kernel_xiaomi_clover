## drivers/kernelsu/Kconfig
```kconfig
menu "KernelSU"

config KSU
	tristate "KernelSU function support"
	depends on OVERLAY_FS
	default y
	help
	  Enable kernel-level root privileges on Android System.
	  To compile as a module, choose M here: the
	  module will be called kernelsu.

config KSU_DEBUG
	bool "KernelSU debug mode"
	depends on KSU
	default n
	help
	  Enable KernelSU debug mode.

config KSU_DISABLE_MANAGER
	bool "Disable KernelSU manager integration"
	depends on KSU
	default n
	help
	  Disable manager APK detection and manager-specific handling.

config KSU_MANUAL_HOOK
	bool "KernelSU manual hook mode"
	depends on KSU && KSU != m
	default y if !KPROBES
	default n
	help
	  Enable manual hook support for non-kprobes kernels.
	  Automatically enabled when KPROBES is not available.

config KSU_KPROBES_HOOK
	bool "KernelSU kprobes hook"
	depends on KSU && !KSU_MANUAL_HOOK
	depends on KPROBES && HAVE_KPROBES && HAVE_SYSCALL_TRACEPOINTS
	default y if KPROBES && HAVE_KPROBES
	help
	  Enable kprobes-based hook for KernelSU.
	  Required for kernels without manual hook support.

menu "KernelSU - SUSFS"

config KSU_SUSFS
	bool "KernelSU addon - SUSFS"
	depends on KSU
	depends on THREAD_INFO_IN_TASK
	default y
	help
	  Patch and Enable SUSFS to kernel with KernelSU.

config KSU_SUSFS_SUS_PATH
	bool "Enable to hide suspicious path (NOT recommended)"
	depends on KSU_SUSFS
	default y
	help
	  Allow hiding the user-defined path and all its sub-paths from various system calls.

config KSU_SUSFS_SUS_MOUNT
	bool "Enable to hide suspicious mounts"
	depends on KSU_SUSFS
	default y
	help
	  Allow hiding the user-defined mount paths from /proc/self/[mounts|mountinfo|mountstat].

config KSU_SUSFS_SUS_KSTAT
	bool "Enable to spoof suspicious kstat"
	depends on KSU_SUSFS
	default y
	help
	  Allow spoofing the kstat of user-defined file/directory.

config KSU_SUSFS_TRY_UMOUNT
	bool "Enable to use ksu's try_umount"
	depends on KSU_SUSFS
	default y
	help
	  Allow using try_umount to umount user-defined mount paths.

config KSU_SUSFS_SPOOF_UNAME
	bool "Enable to spoof uname"
	depends on KSU_SUSFS
	default y
	help
	  Allow spoofing the string returned by uname syscall.

config KSU_SUSFS_ENABLE_LOG
	bool "Enable logging susfs log to kernel"
	depends on KSU_SUSFS
	default y
	help
	  Allow logging susfs log to kernel.

config KSU_SUSFS_HIDE_KSU_SUSFS_SYMBOLS
	bool "Enable to hide ksu and susfs symbols from /proc/kallsyms"
	depends on KSU_SUSFS
	default y
	help
	  Automatically hide ksu and susfs symbols from /proc/kallsyms.

config KSU_SUSFS_SPOOF_CMDLINE_OR_BOOTCONFIG
	bool "Enable to spoof /proc/cmdline (non-gki)"
	depends on KSU_SUSFS
	default y
	help
	  Spoof the output of /proc/cmdline with a user-defined file.

config KSU_SUSFS_OPEN_REDIRECT
	bool "Enable to redirect a path to be opened with another path (experimental)"
	depends on KSU_SUSFS
	default y
	help
	  Allow redirecting a target path to be opened with another user-defined path.

config KSU_SUSFS_SUS_MAP
	bool "Enable to hide some mmapped real file from different proc maps interfaces"
	depends on KSU_SUSFS
	default y
	help
	  Allow hiding mmapped real file from /proc/<pid>/[maps|smaps|smaps_rollup|map_files|mem|pagemap]

endmenu

endmenu
```
